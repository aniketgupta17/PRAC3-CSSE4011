## CMakeLists.txt
```
cmake_minimum_required(VERSION 3.20.0)
   find_package(Zephyr REQUIRED HINTS $ENV{ZEPHYR_BASE})
   project(hello_world)

   # Collect all the source files in src
   FILE(GLOB app_sources src/*.c)

   # Collect all the source files in lib
   FILE(GLOB lib_sources ../lib/*.c)

   # Tell CMake to build with the app and lib sources
   target_sources(app PRIVATE ${app_sources} ${lib_sources})

   # Tell CMake where our header files are
   zephyr_include_directories(../inc)
```

## prj.conf
```kconfig
CONFIG_BT=y
CONFIG_BT_CENTRAL=y
CONFIG_BT_SMP=y
CONFIG_BT_GATT_CLIENT=y
CONFIG_BT_DEBUG_SMP=y
CONFIG_BT=y
CONFIG_BT_PERIPHERAL=y
CONFIG_BT_DEVICE_NAME="Test Device"
CONFIG_BT_DEVICE_APPEARANCE=0
CONFIG_BT_BUF_ACL_RX_SIZE=255
CONFIG_BT_BUF_ACL_TX_SIZE=251
CONFIG_BT_BUF_CMD_TX_SIZE=255
CONFIG_SHELL=y
CONFIG_SHELL_BACKEND_SERIAL=y
CONFIG_KERNEL_SHELL=y
CONFIG_DEVICE_SHELL=y
CONFIG_SHELL_LOG_LEVEL_INF=y
CONFIG_BT=y
CONFIG_HEAP_MEM_POOL_SIZE=2048
CONFIG_BT_L2CAP_TX_MTU=247
CONFIG_LOG=y
CONFIG_PRINTK=y
CONFIG_SHELL=y
CONFIG_LOG=y
CONFIG_LOG_CMDS=y
CONFIG_INIT_STACKS=y
CONFIG_THREAD_STACK_INFO=y
CONFIG_KERNEL_SHELL=y
CONFIG_THREAD_MONITOR=y
CONFIG_BOOT_BANNER=n
CONFIG_THREAD_NAME=y
CONFIG_DEVICE_SHELL=y
CONFIG_DATE_SHELL=y
CONFIG_THREAD_RUNTIME_STATS=y
CONFIG_THREAD_RUNTIME_STATS_USE_TIMING_FUNCTIONS=y
CONFIG_STATS=y
CONFIG_STATS_SHELL=y
# Shell and UART console settings
CONFIG_CONSOLE=y
CONFIG_UART_CONSOLE=y
CONFIG_SHELL_BACKEND_SERIAL=y
CONFIG_SHELL_PROMPT_UART="uart:~$"
# Increase UART buffer to avoid glitches
CONFIG_UART_LINE_CTRL=y
CONFIG_UART_INTERRUPT_DRIVEN=y
CONFIG_UART_CONSOLE=y
CONFIG_SHELL_BACKEND_SERIAL_RX_RING_BUFFER_SIZE=512
CONFIG_SHELL_BACKEND_SERIAL_TX_RING_BUFFER_SIZE=512
# Disable console subsystems that might cause login prompt
CONFIG_CONSOLE_SUBSYS=n
CONFIG_NEWLIB_LIBC=y
CONFIG_NEWLIB_LIBC_FLOAT_PRINTF=y


CONFIG_NEWLIB_LIBC=y
CONFIG_NEWLIB_LIBC_FLOAT_PRINTF=y
```

## src/main.c
```c
#include <zephyr/kernel.h>
#include <zephyr/sys/printk.h>
#include <zephyr/bluetooth/bluetooth.h>
#include <zephyr/bluetooth/hci.h>
#include <zephyr/sys/util.h>
#include <string.h>
#include <math.h>
#include "ibeacon_node_manager.h"


#define POS_PACKET_TYPE       0x02        
#define COMPANY_ID_LSB 0xFF
#define COMPANY_ID_MSB 0xFF
#define NUM_BEACONS 8
#define ULTRASONIC_ADV_DATA_LEN 7
#define ULTRASONIC_PACKET_TYPE 0x01

// Coordinates of beacons
static const double grid_a[NUM_BEACONS][2] = {
    {0.0, 0.0}, {1.5, 0.0}, {3.0, 0.0}, {3.0, 2.0},
    {3.0, 4.0}, {1.5, 4.0}, {0.0, 4.0}, {0.0, 2.0}
};

// // // Per-beacon TX power
// static const float tx_power_dbm[NUM_BEACONS] = {
//     -59, /* A */
//     -65, /* B */
//     -61, /* C */
//     -66, /* D */
//     -66, /* E */
//     -65, /* F */
//     -67, /* G */
//     -47  /* H */
// };

static uint8_t mfg[7];

static const struct bt_data ad[] = {
    BT_DATA(BT_DATA_MANUFACTURER_DATA, mfg, sizeof(mfg)),
};

// Per-beacon TX power
static const float tx_power_dbm[NUM_BEACONS] = {
    -59, /* A */
    -59, /* B */
    -59, /* B */
    -59, /* B */
    -59, /* B */
    -59, /* B */
    -59, /* B */
    -59, /* B */
};

#define PATH_LOSS_N 2.0

static int8_t rssi_values[NUM_BEACONS] = {0};
static bool rssi_updated[NUM_BEACONS] = {false};
static double smoothed_rssi[NUM_BEACONS] = {0}; // For RSSI smoothing
static uint8_t processed_ids = 0;

// Threads
#define RSSI_THREAD_STACK_SIZE 2048
#define FUSION_THREAD_STACK_SIZE 2048
#define THREAD_PRIORITY 5

K_THREAD_STACK_DEFINE(rssi_thread_stack, RSSI_THREAD_STACK_SIZE);
K_THREAD_STACK_DEFINE(fusion_thread_stack, FUSION_THREAD_STACK_SIZE);
static struct k_thread rssi_thread_data;
static struct k_thread fusion_thread_data;

// Message queue for position data
#define QUEUE_SIZE 10

struct fused_position_packet {
    double x;
    double y;
    int64_t timestamp_ms;
    uint8_t source; // 0 = RSSI, 1 = ultrasonic
};

struct position_data {
    double x;
    double y;
    uint8_t source; // 0 for RSSI, 1 for ultrasonic
};

K_MSGQ_DEFINE(position_queue, sizeof(struct position_data), QUEUE_SIZE, 4);

// CLAMP macro
#define CLAMP(val, min, max) (MAX(MIN(val, max), min))

static void format_double(double value, char *buf, size_t buf_size) {
    int integer_part = (int)value;
    int fractional_part = (int)(fabs(value * 100.0)) % 100;
    snprintk(buf, buf_size, "%d.%02d", integer_part, fractional_part);
}

// Kalman filter parameters
#define MEAS_NOISE_RSSI 0.5    // Measurement noise for RSSI (meters)
#define MEAS_NOISE_ULTRA 0.05  // Measurement noise for ultrasonic (meters)
#define PROCESS_NOISE 0.1      // Process noise (meters)

struct kalman_state {
    double x[2];        // State: [x, y]
    double cov[2][2];   // Covariance matrix
};

// Initialize Kalman filter
static struct kalman_state kalman = {
    .x = {0.0, 0.0},   // Start at (0, 0)
    .cov = {
        {1.0, 0.0},
        {0.0, 1.0}
    }
};

static double rssi_to_distance(int8_t rssi, int index) {
    double distance = pow(10.0, (tx_power_dbm[index] - rssi) / (10.0 * PATH_LOSS_N));
    return CLAMP(distance, 0.1, 10.0); // Limit to 0.1–10 meters
}

static void update_rssi(int index, int8_t rssi) {
    const double alpha = 0.3; // Smoothing factor
    if (!rssi_updated[index]) {
        smoothed_rssi[index] = rssi;
    } else {
        smoothed_rssi[index] = alpha * rssi + (1 - alpha) * smoothed_rssi[index];
    }
    rssi_values[index] = (int8_t)smoothed_rssi[index];
    rssi_updated[index] = true;
}

static bool invert2x2(double m[2][2], double inv[2][2]) {
    double det = m[0][0] * m[1][1] - m[0][1] * m[1][0];
    if (fabs(det) < 1e-6) {
        char det_buf[16];
        format_double(det, det_buf, sizeof(det_buf));
        printk("Matrix inversion failed: determinant too small (%s)\n", det_buf);
        return false;
    }
    double inv_det = 1.0 / det;
    inv[0][0] = m[1][1] * inv_det;
    inv[0][1] = -m[0][1] * inv_det;
    inv[1][0] = -m[1][0] * inv_det;
    inv[1][1] = m[0][0] * inv_det;
    return true;
}

static bool multilateration(double *x, double *y) {
    double distances[NUM_BEACONS];
    int valid_indices[NUM_BEACONS];
    int valid_count = 0;

    // Collect valid RSSI measurements
    for (int i = 0; i < NUM_BEACONS; i++) {
        if (rssi_updated[i]) {
            distances[valid_count] = rssi_to_distance(rssi_values[i], i);
            valid_indices[valid_count++] = i;
        }
    }
    // Check for more than 3 beacons
    if (valid_count <= 2) {
        printk("Multilateration failed: %d beacons detected, more than 2 required\n", valid_count);
        return false;
    }
    // Log beacon data
    char dist_buf[16], x_buf[16], y_buf[16];
    for (int i = 0; i < valid_count; i++) {
        int idx = valid_indices[i];
        format_double(distances[i], dist_buf, sizeof(dist_buf));
        format_double(grid_a[idx][0], x_buf, sizeof(x_buf));
        format_double(grid_a[idx][1], y_buf, sizeof(y_buf));
        printk("Beacon %c: RSSI=%d, Distance=%s m, Coord=(%s, %s)\n",
               'A' + idx, rssi_values[idx], dist_buf, x_buf, y_buf);
    }
    // Select reference beacon (strongest RSSI)
    int ref_idx = valid_indices[0];
    int8_t max_rssi = rssi_values[ref_idx];
    for (int i = 1; i < valid_count; i++) {
        int idx = valid_indices[i];
        if (rssi_values[idx] > max_rssi) {
            max_rssi = rssi_values[idx];
            ref_idx = idx;
        }
    }
    double xr = grid_a[ref_idx][0];
    double yr = grid_a[ref_idx][1];
    double dr = 0.0;
    for (int i = 0; i < valid_count; i++) {
        if (valid_indices[i] == ref_idx) {
            dr = distances[i];
            break;
        }
    }

    // Build linear system
    double A[NUM_BEACONS][2], b[NUM_BEACONS];
    int used = valid_count - 1; // Equations = valid_count - 1

    for (int i = 0, j = 0; i < valid_count; i++) {
        if (valid_indices[i] == ref_idx) continue;
        int idx = valid_indices[i];
        double xi = grid_a[idx][0];
        double yi = grid_a[idx][1];
        double di = distances[i];
        A[j][0] = 2.0 * (xi - xr);
        A[j][1] = 2.0 * (yi - yr);
        b[j] = (xi * xi - xr * xr) + (yi * yi - yr * yr) + (dr * dr - di * di);
        j++;
    }
    // Compute normal equations
    double ATA[2][2] = {{0}}, ATb[2] = {0};
    for (int i = 0; i < used; i++) {
        ATA[0][0] += A[i][0] * A[i][0];
        ATA[0][1] += A[i][0] * A[i][1];
        ATA[1][0] += A[i][1] * A[i][0];
        ATA[1][1] += A[i][1] * A[i][1];
        ATb[0] += A[i][0] * b[i];
        ATb[1] += A[i][1] * b[i];
    }
    // Add small regularization for numerical stability
    ATA[0][0] += 1e-4;
    ATA[1][1] += 1e-4;

    // Invert ATA
    double ATA_inv[2][2];
    if (!invert2x2(ATA, ATA_inv)) {
        printk("Multilateration failed: cannot invert ATA\n");
        return false;
    }

    // Solve for position
    *x = ATA_inv[0][0] * ATb[0] + ATA_inv[0][1] * ATb[1] + xr;
    *y = ATA_inv[1][0] * ATb[0] + ATA_inv[1][1] * ATb[1] + yr;

    // Log result
    format_double(*x, x_buf, sizeof(x_buf));
    format_double(*y, y_buf, sizeof(y_buf));
    printk("Multilateration (%d beacons): x=%s, y=%s\n", valid_count, x_buf, y_buf);

    // Clamp to grid
    *x = CLAMP(*x, 0.0, 3.0);
    *y = CLAMP(*y, 0.0, 4.0);
    return true;
}

K_MUTEX_DEFINE(adv_mutex); // Mutex for protecting mfg array

// 2D Kalman filter functions
static void kalman_predict(struct kalman_state *state) {
    // State transition matrix A (identity, assuming static position)
    double A[2][2] = {
        {1.0, 0.0},
        {0.0, 1.0}
    };

    // Process noise covariance Q
    double Q[2][2] = {
        {PROCESS_NOISE, 0.0},
        {0.0, PROCESS_NOISE}
    };

    // Predict state: x = A * x
    double x_temp[2] = {0};
    for (int i = 0; i < 2; i++) {
        for (int j = 0; j < 2; j++) {
            x_temp[i] += A[i][j] * state->x[j];
        }
    }
    memcpy(state->x, x_temp, sizeof(x_temp));

    // Predict covariance: cov = A * cov * A^T + Q
    double temp[2][2] = {0}, cov_temp[2][2] = {0};
    for (int i = 0; i < 2; i++) {
        for (int j = 0; j < 2; j++) {
            for (int k = 0; k < 2; k++) {
                temp[i][j] += A[i][k] * state->cov[k][j];
            }
        }
    }
    for (int i = 0; i < 2; i++) {
        for (int j = 0; j < 2; j++) {
            for (int k = 0; k < 2; k++) {
                cov_temp[i][j] += temp[i][k] * A[j][k];
            }
            cov_temp[i][j] += Q[i][j];
        }
    }
    memcpy(state->cov, cov_temp, sizeof(cov_temp));
}

static void kalman_update(struct kalman_state *state, double obs[2], uint8_t source) {
    // Observation matrix H (identity, observing x, y directly)
    double H[2][2] = {
        {1.0, 0.0},
        {0.0, 1.0}
    };

    // Measurement noise covariance R
    double R[2][2] = {
        {source == 0 ? MEAS_NOISE_RSSI : MEAS_NOISE_ULTRA, 0.0},
        {0.0, source == 0 ? MEAS_NOISE_RSSI : MEAS_NOISE_ULTRA}
    };

    // Measurement residual: error_x = obs - H * x
    double error_x[2] = {0};
    for (int i = 0; i < 2; i++) {
        error_x[i] = obs[i];
        for (int j = 0; j < 2; j++) {
            error_x[i] -= H[i][j] * state->x[j];
        }
    }

    // Residual covariance: error_cov = H * cov * H^T + R
    double temp[2][2] = {0}, error_cov[2][2] = {0};
    for (int i = 0; i < 2; i++) {
        for (int j = 0; j < 2; j++) {
            for (int k = 0; k < 2; k++) {
                temp[i][j] += H[i][k] * state->cov[k][j];
            }
        }
    }
    for (int i = 0; i < 2; i++) {
        for (int j = 0; j < 2; j++) {
            for (int k = 0; k < 2; k++) {
                error_cov[i][j] += temp[i][k] * H[j][k]; // H^T = H
            }
            error_cov[i][j] += R[i][j];
        }
    }

    // Kalman gain: K = cov * H^T * error_cov^-1
    double K[2][2] = {0}, error_cov_inv[2][2];
    if (!invert2x2(error_cov, error_cov_inv)) {
        printk("Kalman update failed: cannot invert error covariance\n");
        return;
    }
    for (int i = 0; i < 2; i++) {
        for (int j = 0; j < 2; j++) {
            for (int k = 0; k < 2; k++) {
                K[i][j] += state->cov[i][k] * H[j][k] * error_cov_inv[k][j];
            }
        }
    }

    // Update state: x = x + K * error_x
    double x_temp[2] = {0};
    for (int i = 0; i < 2; i++) {
        x_temp[i] = state->x[i];
        for (int j = 0; j < 2; j++) {
            x_temp[i] += K[i][j] * error_x[j];
        }
    }
    memcpy(state->x, x_temp, sizeof(x_temp));

    // Update covariance: cov = (I - K * H) * cov
    double KH[2][2] = {0}, I_KH[2][2] = {0};
    for (int i = 0; i < 2; i++) {
        for (int j = 0; j < 2; j++) {
            for (int k = 0; k < 2; k++) {
                KH[i][j] += K[i][k] * H[k][j];
            }
            I_KH[i][j] = (i == j ? 1.0 : 0.0) - KH[i][j];
        }
    }
    double cov_temp[2][2] = {0};
    for (int i = 0; i < 2; i++) {
        for (int j = 0; j < 2; j++) {
            for (int k = 0; k < 2; k++) {
                cov_temp[i][j] += I_KH[i][k] * state->cov[k][j];
            }
        }
    }
    memcpy(state->cov, cov_temp, sizeof(cov_temp));
}

static void scan_recv(const struct bt_le_scan_recv_info *info, struct net_buf_simple *buf) {
    if (!info || !buf || buf->len == 0) return;

    uint8_t *data = buf->data;
    size_t len = buf->len;
    size_t i = 0;

    while (i + 1 < len) {
        uint8_t field_len = data[i];
        if (field_len == 0 || i + field_len >= len) break;

        uint8_t field_type = data[i + 1];
        if (field_type == BT_DATA_MANUFACTURER_DATA) {
            uint8_t *m = &data[i + 2];
            size_t mlen = field_len - 1;

            if (mlen >= 4 && m[0] == COMPANY_ID_LSB && m[1] == COMPANY_ID_MSB) {
                // printk("[DEBUG] Matched iBeacon packet header (Company ID)\n");
                     

                int8_t rssi = (int8_t)m[2];
                char id = (char)m[8];

                if (is_ibeacon_node(id, NULL)) {
            
                if (id >= 'A' && id <= 'H') {
                    int index = id - 'A';
            
                    if (!(processed_ids & (1 << index))) {
                        update_rssi(index, rssi);
                        processed_ids |= (1 << index);
            
                        char rssi_buf[16];
                        format_double(smoothed_rssi[index], rssi_buf, sizeof(rssi_buf));
                        printk("Detection: Beacon %c RSSI=%s\n", id, rssi_buf);
                    } else {
                    }
                } else {
                    printk("[WARN] ID %c out of expected range A–H. Ignored.\n", id);
                }
            }}
              if (mlen >= ULTRASONIC_ADV_DATA_LEN && m[0] == 0xAA && m[1] == 0xAA && m[2] == ULTRASONIC_PACKET_TYPE) {
                uint8_t node_id = m[3];
                uint8_t x_ultra = m[4];
                uint16_t y_ultra = ((uint16_t)m[6] << 8) | m[5];
                printk("Ultrasonic Node %d: x=%d, y=%d mm\n", node_id, x_ultra, y_ultra);

                // Enqueue ultrasonic position (convert mm to meters)
                struct position_data pos = {
                    .x = 0,
                    .y = y_ultra / 1000.0,
                    .source = 1 // Ultrasonic
                };

                if (y_ultra == 4000) {
                    printk("Ultrasonic Node %d: Invalid reading (y=4000), skipped\n", node_id);
                    continue;             }

                k_msgq_put(&position_queue, &pos, K_NO_WAIT);
            }
             if (mlen >= ULTRASONIC_ADV_DATA_LEN && m[0] == 0xBB && m[1] == 0xBB && m[2] == ULTRASONIC_PACKET_TYPE )  {
                uint8_t node_id = m[3];
                uint8_t x_ultra = m[4];
                uint16_t y_ultra = ((uint16_t)m[6] << 8) | m[5];
                printk("Ultrasonic Node two %d: x=%d, y=%d mm\n", node_id, x_ultra, y_ultra);

                // Enqueue ultrasonic position (convert mm to meters)
                struct position_data pos = {
                    .x = 0,
                    .y = y_ultra / 1000.0,
                    .source = 1 // Ultrasonic
                };

                if (y_ultra == 4000) {
                    printk("Ultrasonic Node %d: Invalid reading (y=4000), skipped\n", node_id);
                    continue; // Exit current handler or block
                }

                k_msgq_put(&position_queue, &pos, K_NO_WAIT);
            }
        }
        i += field_len + 1;
    }
}

static struct bt_le_scan_cb unified_scan_callbacks = {
    .recv = scan_recv,
};

static void rssi_thread(void *p1, void *p2, void *p3) {
    printk("RSSI thread started\n");

    struct bt_le_scan_param scan_param = {
        .type = BT_LE_SCAN_TYPE_PASSIVE,
        .options = BT_LE_SCAN_OPT_FILTER_DUPLICATE,
        .interval = 0x0020, // 20ms
        .window = 0x0010,   // 10ms
    };

    if (bt_le_scan_start(&scan_param, NULL)) {
        printk("Scan start failed!\n");
        return;
    }

    while (1) {
        k_sleep(K_SECONDS(3)); 
        processed_ids = 0;

        double x_rssi, y_rssi;
        if (multilateration(&x_rssi, &y_rssi)) {
            char pos_buf[64];
            snprintk(pos_buf, sizeof(pos_buf), "RSSI Position: x=%d.%02d y=%d.%02d\n",
                     (int)x_rssi, (int)(fabs(x_rssi * 100)) % 100,
                     (int)y_rssi, (int)(fabs(y_rssi * 100)) % 100);
            printk("%s", pos_buf);

            // Enqueue RSSI position
            struct position_data pos = {
                .x = x_rssi,
                .y = y_rssi,
                .source = 0 // RSSI
            };
            k_msgq_put(&position_queue, &pos, K_NO_WAIT);
        }

        memset(rssi_updated, 0, sizeof(rssi_updated));
    }
}

void send_position_adv(double x_m, double y_m) {
    // Convert meters to centimeters and clamp to grid size (300 cm × 400 cm)
    uint16_t x_cm = CLAMP((uint16_t)lrint(x_m * 100.0), 0, 300);
    uint16_t y_cm = CLAMP((uint16_t)lrint(y_m * 100.0), 0, 400);
    uint32_t timestamp_ms = (uint32_t)k_uptime_get();  // fits in 4 bytes

    // Update mfg array with new position data
    uint8_t temp_mfg[11] = {
        COMPANY_ID_LSB,
        COMPANY_ID_MSB,
        POS_PACKET_TYPE,
        (uint8_t)(x_cm & 0xFF),
        (uint8_t)(x_cm >> 8),
        (uint8_t)(y_cm & 0xFF),
        (uint8_t)(y_cm >> 8),
        (uint8_t)(timestamp_ms & 0xFF),
        (uint8_t)((timestamp_ms >> 8) & 0xFF),
        (uint8_t)((timestamp_ms >> 16) & 0xFF),
        (uint8_t)((timestamp_ms >> 24) & 0xFF)
    };
    printk("MFG data: ");
    for (int i = 0; i < 11; i++) {
        printk("%02X ", temp_mfg[i]);
    }
    printk("\n");
    // Copy to global mfg array atomically to avoid race conditions
    k_mutex_lock(&adv_mutex, K_FOREVER);
    memcpy(mfg, temp_mfg, sizeof(mfg));
    k_mutex_unlock(&adv_mutex);

    // Update advertisement data
    int err = bt_le_adv_update_data(ad, ARRAY_SIZE(ad), NULL, 0);
    if (err) {
        printk("Failed to update advertisement data (err %d)\n", err);
    } else {
        printk("Updated advertisement: x=%u cm, y=%u cm\n", x_cm, y_cm);
    }
}

void start_advertising(void) {
    struct bt_le_adv_param adv_param = {
        .id = BT_ID_DEFAULT,
        .sid = 0,
        .secondary_max_skip = 0,
        .options = BT_LE_ADV_OPT_NONE,
        .interval_min = BT_GAP_ADV_FAST_INT_MIN_2, // 100 ms
        .interval_max = BT_GAP_ADV_FAST_INT_MAX_2, // 150 ms
        .peer = NULL,
    };

    int err = bt_le_adv_start(&adv_param, ad, ARRAY_SIZE(ad), NULL, 0);
    if (err) {
        printk("Advertising start failed (err %d)\n", err);
    } else {
        printk("Started advertising\n");
    }
}


static void fusion_thread(void *p1, void *p2, void *p3) {
    printk("Fusion thread started\n");

    char fused_buf[64], x_buf[16], y_buf[16];
    while (1) {
        struct position_data pos;
        if (k_msgq_get(&position_queue, &pos, K_MSEC(500)) == 0) {
            double obs[2] = {pos.x, pos.y};
            kalman_predict(&kalman);
            kalman_update(&kalman, obs, pos.source);

            format_double(kalman.x[0], x_buf, sizeof(x_buf));
            format_double(kalman.x[1], y_buf, sizeof(y_buf));
            snprintk(fused_buf, sizeof(fused_buf), "** Fused Position: x=%s y=%s (%s) **\n",
                     x_buf, y_buf, pos.source == 0 ? "RSSI" : "Ultrasonic");
            printk("%s", fused_buf);

            // Update advertisement with fused position
            send_position_adv(kalman.x[0], kalman.x[1]);
        } else {
            kalman_predict(&kalman);
        }
    }
}


void main(void) {
    printk("Bluetooth RSSI and Ultrasonic localization with 2D Kalman filter started\n");

    if (bt_enable(NULL)) {
        printk("Bluetooth init failed!\n");
        return;
    }

    start_advertising();
    ibeacon_node_manager_init();


    bt_le_scan_cb_register(&unified_scan_callbacks);

    
    k_thread_create(&rssi_thread_data, rssi_thread_stack,
                    K_THREAD_STACK_SIZEOF(rssi_thread_stack),
                    rssi_thread, NULL, NULL, NULL,
                    THREAD_PRIORITY, 0, K_NO_WAIT);

    k_thread_create(&fusion_thread_data, fusion_thread_stack,
                    K_THREAD_STACK_SIZEOF(fusion_thread_stack),
                    fusion_thread, NULL, NULL, NULL,
                    THREAD_PRIORITY, 0, K_NO_WAIT);
}
```

## src/central_gatt_write.c
```c
/*
 * Copyright (c) 2022 Nordic Semiconductor ASA
 *
 * SPDX-License-Identifier: Apache-2.0
 */

 #include <zephyr/kernel.h>
 #include <zephyr/sys/printk.h>
 #include <zephyr/bluetooth/bluetooth.h>
 #include <zephyr/bluetooth/conn.h>
 #include <zephyr/bluetooth/gatt.h>
 #include <zephyr/bluetooth/hci.h>
 
 static struct bt_uuid_128 service_uuid = BT_UUID_INIT_128(
     0x11, 0x11, 0x11, 0x11, 0x11, 0x11, 0x11, 0x11,
     0x11, 0x11, 0x11, 0x11, 0x11, 0x11, 0x11, 0x11
 );
 static struct bt_uuid_16 char_uuid = BT_UUID_INIT_16(1849);
 static struct bt_uuid_16 uuid = BT_UUID_INIT_16(1849); // In read_cmd // Appearance (fallback)
 
 static struct bt_gatt_discover_params discover_params;
 static struct bt_gatt_read_params read_params;
 static uint16_t char_handle = 0;
 static uint16_t service_end_handle = 0xffff; // Track service end handle
 
 extern int mtu_exchange(struct bt_conn *conn);
//  extern int write_cmd(struct bt_conn *conn);
 extern struct bt_conn *conn_connected;
 extern uint32_t last_write_rate;
 extern void (*start_scan_func)(void);
 
 /* Flag to track if the target UUID was found */
 static bool uuid_found_flag = false;
 
 /* Log raw advertising data for debugging */
 static void log_ad_data(struct net_buf_simple *ad)
 {
     printk("Raw AD data (len %u): ", ad->len);
     for (size_t i = 0; i < ad->len; i++) {
         printk("%02x ", ad->data[i]);
     }
     printk("\n");
 }
 
 /* Callback to parse advertising data and check for service UUID */
 static bool ad_data_cb(struct bt_data *data, void *user_data)
 {
     struct bt_uuid *target_uuid = (struct bt_uuid *)user_data;
 
     /* Log each AD structure */
     printk("AD type 0x%02x, len %u: ", data->type, data->data_len);
     for (size_t i = 0; i < data->data_len; i++) {
         printk("%02x ", data->data[i]);
     }
     printk("\n");
 
     /* Check for 128-bit UUIDs (complete or incomplete list) */
     if (data->type == BT_DATA_UUID128_SOME || data->type == BT_DATA_UUID128_ALL) {
         printk("Found 128-bit UUID list (type 0x%02x, len %u): ", data->type, data->data_len);
         /* Each UUID in the data is 16 bytes (128-bit UUID) */
         for (size_t i = 0; i < data->data_len; i += 16) {
             struct bt_uuid_128 uuid;
             memcpy(uuid.val, &data->data[i], 16);
             uuid.uuid.type = BT_UUID_TYPE_128;
             printk("0x");
             for (int j = 15; j >= 0; j--) {
                 printk("%02x", uuid.val[j]);
                 if (j == 12 || j == 10 || j == 8 || j == 6) {
                     printk("-");
                 }
             }
             if (bt_uuid_cmp(&uuid.uuid, target_uuid) == 0) {
                 uuid_found_flag = true;
                 printk(" (matches target UUID)");
                 return false; /* Stop parsing */
             }
             printk(" ");
         }
         printk("\n");
     }
 
     return true; /* Continue parsing */
 }
 
 static uint8_t read_cb(struct bt_conn *conn, uint8_t err,
    struct bt_gatt_read_params *params,
    const void *data, uint16_t length)
{
printk("✅ read_cb() triggered. err=%d, len=%d\n", err, length);
if (err) {
printk("Read failed (err %d)\n", err);
} else if (data) {
printk("Read %d bytes: ", length);
for (int i = 0; i < length; i++) {
printk("%02x ", ((const uint8_t *)data)[i]);
}
printk("\n");
} else {
printk("Read complete (no more data)\n");
}

return BT_GATT_ITER_STOP;
}

 
 static uint8_t characteristic_discover_func(struct bt_conn *conn,
                                            const struct bt_gatt_attr *attr,
                                            struct bt_gatt_discover_params *params)
 {
     if (!attr) {
         printk("Characteristic discovery complete, no characteristic found for UUID 0x%04x\n", char_uuid.val);
         bt_conn_disconnect(conn, BT_HCI_ERR_REMOTE_USER_TERM_CONN);
         return BT_GATT_ITER_STOP;
     }
 
     struct bt_gatt_chrc *chrc = (struct bt_gatt_chrc *)attr->user_data;
     uint16_t uuid_val = (chrc->uuid->type == BT_UUID_TYPE_16) ? ((struct bt_uuid_16 *)chrc->uuid)->val : 0;
 
     printk("Found characteristic handle: %u, value handle: %u, UUID 0x%04x\n",
            attr->handle, chrc->value_handle, uuid_val);
 
     char_handle = chrc->value_handle;
 
     memset(&read_params, 0, sizeof(read_params));
     read_params.func = read_cb;
     read_params.handle_count = 1;
     read_params.single.handle = char_handle;
     read_params.single.offset = 0;
 
     int err = bt_gatt_read(conn, &read_params);
     if (err) {
         printk("Read failed (err %d)\n", err);
     }
     printk("✅ Discovery and reading process completed successfully.\n");

     return BT_GATT_ITER_STOP;
 }
 
 static uint8_t service_discover_func(struct bt_conn *conn,
                                     const struct bt_gatt_attr *attr,
                                     struct bt_gatt_discover_params *params)
 {
     if (!attr) {
         printk("Service discovery complete, no service found\n");
         bt_conn_disconnect(conn, BT_HCI_ERR_REMOTE_USER_TERM_CONN);
         return BT_GATT_ITER_STOP;
     }
 
     struct bt_gatt_service_val *service = (struct bt_gatt_service_val *)attr->user_data;
     if (service->uuid->type == BT_UUID_TYPE_128) {
         struct bt_uuid_128 *uuid = (struct bt_uuid_128 *)service->uuid;
         printk("Found service. Handle: %u, UUID 0x", attr->handle);
         for (int i = 15; i >= 0; i--) {
             printk("%02x", uuid->val[i]);
             if (i == 12 || i == 10 || i == 8 || i == 6) {
                 printk("-");
             }
         }
         printk(", End Handle: %u\n", service->end_handle);
     } else {
         printk("Found service. Handle: %u, UUID type %u, End Handle: %u\n",
                attr->handle, service->uuid->type, service->end_handle);
     }
 
     service_end_handle = service->end_handle;
 
     memset(&discover_params, 0, sizeof(discover_params));
     discover_params.uuid = &char_uuid.uuid;
     discover_params.start_handle = attr->handle + 1;
     discover_params.end_handle = service_end_handle;
     discover_params.type = BT_GATT_DISCOVER_CHARACTERISTIC;
     discover_params.func = characteristic_discover_func;
 
     int err = bt_gatt_discover(conn, &discover_params);
     if (err) {
         printk("Characteristic discovery failed (err %d)\n", err);
         bt_conn_disconnect(conn, BT_HCI_ERR_REMOTE_USER_TERM_CONN);
     }
 
     return BT_GATT_ITER_STOP;
 }
 
 int discover_and_read(struct bt_conn *conn)
 {
     memset(&discover_params, 0, sizeof(discover_params));
 
     discover_params.uuid = &service_uuid.uuid;
     discover_params.func = service_discover_func;
     discover_params.start_handle = 0x0001;
     discover_params.end_handle = 0xffff;
     discover_params.type = BT_GATT_DISCOVER_PRIMARY;
 
     int err = bt_gatt_discover(conn, &discover_params);
     if (err) {
         printk("Service discovery failed (err %d)\n", err);
         bt_conn_disconnect(conn, BT_HCI_ERR_REMOTE_USER_TERM_CONN);
     }
 
     return err;
 }
 
 int read_cmd(struct bt_conn *conn)
 {
     static struct bt_gatt_read_params read_params;
     static struct bt_uuid_16 uuid = BT_UUID_INIT_16(1849); // Match char_uuid
 
     memset(&read_params, 0, sizeof(read_params));
 
     read_params.func = read_cb;
     read_params.by_uuid.uuid = &uuid.uuid;
     read_params.by_uuid.start_handle = 0x0001;
     read_params.by_uuid.end_handle = 0xffff;
 
     int err = bt_gatt_read(conn, &read_params);
     if (err) {
         printk("bt_gatt_read failed (err %d)\n", err);
     }
 
     return err;
 }
 
 static void device_found(const bt_addr_le_t *addr, int8_t rssi, uint8_t type,
                         struct net_buf_simple *ad)
 {
     char dev[BT_ADDR_LE_STR_LEN];
     struct bt_conn *conn;
     int err;
     if (!is_ibeacon_node(NULL, addr)) {
        printk("Device %s not in iBeacon list, ignoring\n", dev);
        return;
    }
     bt_addr_le_to_str(addr, dev, sizeof(dev));
     printk("[DEVICE]: %s, AD evt type %u, AD data len %u, RSSI %i\n",
            dev, type, ad->len, rssi);
 
     /* Log raw advertising data */
     log_ad_data(ad);
 
     /* Parse advertising data or scan response to log UUIDs */
     uuid_found_flag = false;
     bt_data_parse(ad, ad_data_cb, &service_uuid);
 
     /* Log whether it’s connectable */
     if (type != BT_GAP_ADV_TYPE_ADV_IND && type != BT_GAP_ADV_TYPE_ADV_DIRECT_IND) {
         printk("Non-connectable advertisement (type %u)\n", type);
         /* For debugging, proceed with scan responses to check UUID */
         if (type == BT_GAP_ADV_TYPE_SCAN_RSP && uuid_found_flag) {
             printk("Scan response contains target UUID, but not connectable\n");
         }
         return;
     }
 
     /* Filter by RSSI (disabled for debugging) */
     // if (rssi < -90) {
     //     printk("RSSI too low (%i < -90)\n", rssi);
     //     return;
     // }
 
     /* Check if the target UUID was found */
     if (!uuid_found_flag) {
         printk("Service UUID 11111111-1111-1111-1111-111111111111 not found in advertisement\n");
         return;
     }
 
     printk("Found device advertising service UUID 11111111-1111-1111-1111-111111111111\n");
 
     /* Stop scanning */
     err = bt_le_scan_stop();
     if (err) {
         printk("%s: Stop LE scan failed (err %d)\n", __func__, err);
         return;
     }
 
     /* Connection parameters */
     static const struct bt_le_conn_param conn_params = {
         .interval_min = BT_GAP_INIT_CONN_INT_MIN,
         .interval_max = BT_GAP_INIT_CONN_INT_MAX,
         .latency = 0,
         .timeout = 3000, /* 30 seconds */
     };
 
     /* Attempt to connect */
     err = bt_conn_le_create(addr, BT_CONN_LE_CREATE_CONN, &conn_params, &conn);
     if (err) {
         printk("%s: Create conn failed (err %d)\n", __func__, err);
         start_scan_func();
     } else {
        //  bt_conn_unref(conn);
     }
 }
 
 static void start_scan(void)
 {
     int err;
 
     /* Custom scan parameters for better detection */
     static const struct bt_le_scan_param scan_param = {
         .type = BT_LE_SCAN_TYPE_ACTIVE, /* Active scanning */
         .options = BT_LE_SCAN_OPT_NONE,
         .interval = BT_GAP_SCAN_FAST_INTERVAL, /* 0x0040 (40 ms) */
         .window = BT_GAP_SCAN_FAST_WINDOW,     /* 0x0030 (30 ms) */
         .timeout = 0, /* No timeout */
     };
 
     err = bt_le_scan_start(&scan_param, device_found);
     if (err) {
         printk("%s: Scanning failed to start (err %d)\n", __func__, err);
         return;
     }
 
     printk("%s: Scanning successfully started\n", __func__);
 }
 
 static void auth_cancel(struct bt_conn *conn)
 {
     printk("Pairing cancelled\n");
 }
 
 static void pairing_confirm(struct bt_conn *conn)
 {
     printk("Pairing confirmed\n");
     bt_conn_auth_pairing_confirm(conn);
 }
 
 static struct bt_conn_auth_cb auth_cb = {
     .cancel = auth_cancel,
     .pairing_confirm = pairing_confirm,
     /* Removed passkey_entry and passkey_display */
 };
 
 static void connected(struct bt_conn *conn, uint8_t err)
 {
     char addr[BT_ADDR_LE_STR_LEN];
     struct bt_conn_info info;
 
     bt_addr_le_to_str(bt_conn_get_dst(conn), addr, sizeof(addr));
     if (err) {
         printk("Connection failed (err %d)\n", err);
         start_scan_func();
     } else {
         err = bt_conn_get_info(conn, &info);
         if (err) {
             printk("Failed to get connection info (err %d)\n", err);
         } else {
             printk("Connected to %s, role %d\n", addr, info.role);
             conn_connected = conn;
             /* Try BT_SECURITY_NONE for testing */
             err = bt_conn_set_security(conn,    BT_SECURITY_L0);
             if (err) {
                 printk("Failed to set security (err %d)\n", err);
             }
         }
     }
 }
 
 static void disconnected(struct bt_conn *conn, uint8_t reason)
 {
     char addr[BT_ADDR_LE_STR_LEN];
     bt_addr_le_to_str(bt_conn_get_dst(conn), addr, sizeof(addr));
     printk("Disconnected from %s (reason 0x%02x)\n", addr, reason);
     conn_connected = NULL;
     service_end_handle = 0xffff;
     start_scan_func();
 }
 
 static void security_changed(struct bt_conn *conn, bt_security_t level, enum bt_security_err err)
 {
     char addr[BT_ADDR_LE_STR_LEN];
     bt_addr_le_to_str(bt_conn_get_dst(conn), addr, sizeof(addr));
     if (!err) {
         printk("Security changed for %s: level %u\n", addr, level);
     } else {
         printk("Security failed for %s: level %u, err %u\n", addr, level, err);
     }
 }
 
 void mtu_updated(struct bt_conn *conn, uint16_t tx, uint16_t rx)
 {
     printk("Updated MTU: TX: %d RX: %d bytes\n", tx, rx);
 }
 
 static struct bt_conn_cb conn_callbacks = {
     .connected = connected,
     .disconnected = disconnected,
     .security_changed = security_changed,
 };
 
 static struct bt_gatt_cb gatt_callbacks = {
     .att_mtu_updated = mtu_updated
 };
 
 uint32_t central_gatt_write(uint32_t count)
 {
     int err;
 count=1;
     err = bt_enable(NULL);
     if (err) {
         printk("Bluetooth init failed (err %d)\n", err);
         return 0U;
     }
     printk("Bluetooth initialized\n");
 
     bt_conn_auth_cb_register(&auth_cb);
     bt_conn_cb_register(&conn_callbacks);
     bt_gatt_cb_register(&gatt_callbacks);
 
     conn_connected = NULL;
     last_write_rate = 0U;
     service_end_handle = 0xffff;
 
     start_scan_func = start_scan;
     start_scan_func();
 
     while (true) {
         struct bt_conn *conn = NULL;
 
         if (conn_connected) {
             conn = bt_conn_ref(conn_connected);
         }
 
         if (conn) {
             err = discover_and_read(conn);
             if (err) {
                 printk("Discovery failed (err %d)\n", err);
                 bt_conn_disconnect(conn, BT_HCI_ERR_REMOTE_USER_TERM_CONN);
                 bt_conn_unref(conn);
                 break;
             }
 
             bt_conn_unref(conn);
             count =1;
             if (count) {
                 count--;
                 if (!count) {
                     break;
                 }
             }
 
             k_yield();
         } else {
             k_sleep(K_SECONDS(1));
         }
     }
  printk("Executed");
     return last_write_rate;
 }
```

## src/gatt_write_common.c
```c
/*
* Copyright (c) 2022 Nordic Semiconductor ASA
*
* SPDX-License-Identifier: Apache-2.0
*/

#include <zephyr/kernel.h>
#include <zephyr/sys/printk.h>

#include <zephyr/bluetooth/bluetooth.h>
#include <zephyr/bluetooth/conn.h>
#include <zephyr/bluetooth/gatt.h>
#include <zephyr/bluetooth/hci.h>

/* Count down number of metrics intervals before performing a PHY update */
#define PHY_UPDATE_COUNTDOWN 3U
static uint32_t phy_update_countdown;
static uint8_t phy_param_idx;

static void phy_update_iterate(struct bt_conn *conn)
{
 const struct bt_conn_le_phy_param phy_param[] = {
	 /* List of 1M Tx with Rx on other PHYs */
	 {
		 .options = BT_CONN_LE_PHY_OPT_NONE,
		 .pref_tx_phy = BT_GAP_LE_PHY_1M,
		 .pref_rx_phy = BT_GAP_LE_PHY_1M,
	 }, {
		 .options = BT_CONN_LE_PHY_OPT_NONE,
		 .pref_tx_phy = BT_GAP_LE_PHY_1M,
		 .pref_rx_phy = BT_GAP_LE_PHY_2M,
	 }, {
		 .options = BT_CONN_LE_PHY_OPT_NONE,
		 .pref_tx_phy = BT_GAP_LE_PHY_1M,
		 .pref_rx_phy = BT_GAP_LE_PHY_CODED,
	 },

	 /* List of 2M Tx with Rx on other PHYs */
	 {
		 .options = BT_CONN_LE_PHY_OPT_NONE,
		 .pref_tx_phy = BT_GAP_LE_PHY_2M,
		 .pref_rx_phy = BT_GAP_LE_PHY_1M,
	 }, {
		 .options = BT_CONN_LE_PHY_OPT_NONE,
		 .pref_tx_phy = BT_GAP_LE_PHY_2M,
		 .pref_rx_phy = BT_GAP_LE_PHY_2M,
	 }, {
		 .options = BT_CONN_LE_PHY_OPT_NONE,
		 .pref_tx_phy = BT_GAP_LE_PHY_2M,
		 .pref_rx_phy = BT_GAP_LE_PHY_CODED,
	 },

	 /* List of Coded PHY S8 Tx with Rx on other PHYs */
	 {
		 .options = BT_CONN_LE_PHY_OPT_CODED_S8,
		 .pref_tx_phy = BT_GAP_LE_PHY_CODED,
		 .pref_rx_phy = BT_GAP_LE_PHY_1M,
	 }, {
		 .options = BT_CONN_LE_PHY_OPT_CODED_S8,
		 .pref_tx_phy = BT_GAP_LE_PHY_CODED,
		 .pref_rx_phy = BT_GAP_LE_PHY_2M,
	 }, {
		 .options = BT_CONN_LE_PHY_OPT_CODED_S8,
		 .pref_tx_phy = BT_GAP_LE_PHY_CODED,
		 .pref_rx_phy = BT_GAP_LE_PHY_CODED,
	 },

	 /* List of Coded PHY S2 Tx with Rx on other PHYs */
	 {
		 .options = BT_CONN_LE_PHY_OPT_CODED_S2,
		 .pref_tx_phy = BT_GAP_LE_PHY_CODED,
		 .pref_rx_phy = BT_GAP_LE_PHY_1M,
	 }, {
		 .options = BT_CONN_LE_PHY_OPT_CODED_S2,
		 .pref_tx_phy = BT_GAP_LE_PHY_CODED,
		 .pref_rx_phy = BT_GAP_LE_PHY_2M,
	 }, {
		 .options = BT_CONN_LE_PHY_OPT_CODED_S2,
		 .pref_tx_phy = BT_GAP_LE_PHY_CODED,
		 .pref_rx_phy = BT_GAP_LE_PHY_CODED,
	 },

	 /* Finally stop at 2M Tx with Rx on 2M */
	 {
		 .options = BT_CONN_LE_PHY_OPT_NONE,
		 .pref_tx_phy = BT_GAP_LE_PHY_2M,
		 .pref_rx_phy = BT_GAP_LE_PHY_2M,
	 },
 };
 int err;

 if (phy_update_countdown--) {
	 return;
 }

 phy_update_countdown = PHY_UPDATE_COUNTDOWN;

 phy_param_idx++;
 if (phy_param_idx >= ARRAY_SIZE(phy_param)) {
	 /* No more PHY updates, stay at the last index */
	 phy_param_idx = ARRAY_SIZE(phy_param);
	 return;
 }

 struct bt_conn_info conn_info;

 err = bt_conn_get_info(conn, &conn_info);
 if (err) {
	 printk("Failed to get connection info (%d).\n", err);
	 return;
 }

 struct bt_conn_le_phy_param conn_phy_param;

 if (conn_info.role == BT_CONN_ROLE_CENTRAL) {
	 conn_phy_param.options = phy_param[phy_param_idx].options;
	 conn_phy_param.pref_tx_phy = phy_param[phy_param_idx].pref_tx_phy;
	 conn_phy_param.pref_rx_phy = phy_param[phy_param_idx].pref_rx_phy;
 } else {
	 conn_phy_param.options = phy_param[phy_param_idx].options;
	 conn_phy_param.pref_tx_phy = phy_param[phy_param_idx].pref_rx_phy;
	 conn_phy_param.pref_rx_phy = phy_param[phy_param_idx].pref_tx_phy;
 }

 printk("%s: PHY Update requested %u %u (%u)\n", __func__,
				conn_phy_param.pref_tx_phy,
				conn_phy_param.pref_rx_phy,
				conn_phy_param.options);

 err = bt_conn_le_phy_update(conn, &conn_phy_param);
 if (err) {
	 printk("Failed to update PHY (%d).\n", err);
	 return;
 }
}

/* Interval between storing the measured write rate */
#define METRICS_INTERVAL 1U /* seconds */

static struct bt_gatt_exchange_params mtu_exchange_params;
static uint32_t write_count;
static uint32_t write_len;
static uint32_t write_rate;

/* Globals, reused by central_gatt_write and peripheral_gatt_write samples */
struct bt_conn *conn_connected;
uint32_t last_write_rate;
void (*start_scan_func)(void);

static void write_cmd_cb(struct bt_conn *conn, void *user_data)
{
 static uint32_t cycle_stamp;
 uint64_t delta;

 delta = k_cycle_get_32() - cycle_stamp;
 delta = k_cyc_to_ns_floor64(delta);

 if (delta == 0) {
	 /* Skip division by zero */
	 return;
 }

 /* if last data rx-ed was greater than 1 second in the past,
	* reset the metrics.
	*/
 if (delta > (METRICS_INTERVAL * NSEC_PER_SEC)) {
	 printk("%s: count= %u, len= %u, rate= %u bps.\n", __func__,
					write_count, write_len, write_rate);

	 last_write_rate = write_rate;

	 write_count = 0U;
	 write_len = 0U;
	 write_rate = 0U;
	 cycle_stamp = k_cycle_get_32();

	 if (IS_ENABLED(CONFIG_BT_USER_PHY_UPDATE)) {
		 phy_update_iterate(conn);
	 }

 } else {
	 uint16_t len;

	 write_count++;

	 /* Extract the 16-bit data length stored in user_data */
	 len = (uint32_t)user_data & 0xFFFF;

	 write_len += len;
	 write_rate = ((uint64_t)write_len << 3) * (METRICS_INTERVAL * NSEC_PER_SEC) /
					delta;
 }
}

static void mtu_exchange_cb(struct bt_conn *conn, uint8_t err,
				 struct bt_gatt_exchange_params *params)
{
 printk("%s: MTU exchange %s (%u)\n", __func__,
				err == 0U ? "successful" : "failed",
				bt_gatt_get_mtu(conn));
}

static int mtu_exchange(struct bt_conn *conn)
{
 int err;

 printk("%s: Current MTU = %u\n", __func__, bt_gatt_get_mtu(conn));

 mtu_exchange_params.func = mtu_exchange_cb;

 printk("%s: Exchange MTU...\n", __func__);
 err = bt_gatt_exchange_mtu(conn, &mtu_exchange_params);
 if (err) {
	 printk("%s: MTU exchange failed (err %d)", __func__, err);
 }

 return err;
}

static void connected(struct bt_conn *conn, uint8_t conn_err)
{
 struct bt_conn_info conn_info;
 char addr[BT_ADDR_LE_STR_LEN];
 int err;

 bt_addr_le_to_str(bt_conn_get_dst(conn), addr, sizeof(addr));

 if (conn_err) {
	 printk("%s: Failed to connect to %s (%u)\n", __func__, addr,
					conn_err);
	 return;
 }

 err = bt_conn_get_info(conn, &conn_info);
 if (err) {
	 printk("Failed to get connection info (%d).\n", err);
	 return;
 }

 printk("%s: %s role %u\n", __func__, addr, conn_info.role);

 conn_connected = bt_conn_ref(conn);

 (void)mtu_exchange(conn);

#if defined(CONFIG_BT_SMP)
 if (conn_info.role == BT_CONN_ROLE_CENTRAL) {
	 err = bt_conn_set_security(conn, BT_SECURITY_L2);
	 if (err) {
		 printk("Failed to set security (%d).\n", err);
	 }
 }
#endif

 if (IS_ENABLED(CONFIG_BT_USER_PHY_UPDATE)) {
	 phy_update_countdown = PHY_UPDATE_COUNTDOWN;
	 phy_param_idx = 0U;
 }
}

static void disconnected(struct bt_conn *conn, uint8_t reason)
{
 struct bt_conn_info conn_info;
 char addr[BT_ADDR_LE_STR_LEN];
 int err;

 bt_addr_le_to_str(bt_conn_get_dst(conn), addr, sizeof(addr));

 err = bt_conn_get_info(conn, &conn_info);
 if (err) {
	 printk("Failed to get connection info (%d).\n", err);
	 return;
 }

 // printk("%s: %s role %u, reason %u %s\n", __func__, addr, conn_info.role,
 //        reason, bt_hci_err_to_str(reason));

 conn_connected = NULL;

 bt_conn_unref(conn);

 if (conn_info.role == BT_CONN_ROLE_CENTRAL) {
	 start_scan_func();
 }
}

static bool le_param_req(struct bt_conn *conn, struct bt_le_conn_param *param)
{
 printk("%s: int (0x%04x, 0x%04x) lat %u to %u\n", __func__,
				param->interval_min, param->interval_max, param->latency,
				param->timeout);

 return true;
}

static void le_param_updated(struct bt_conn *conn, uint16_t interval,
					uint16_t latency, uint16_t timeout)
{
 printk("%s: int 0x%04x lat %u to %u\n", __func__, interval,
				latency, timeout);
}

#if defined(CONFIG_BT_SMP)
static void security_changed(struct bt_conn *conn, bt_security_t level,
					enum bt_security_err err)
{
 // printk("%s: to level %u, err %s(%u)\n", __func__, level, bt_security_err_to_str(err), err);
}
#endif

#if defined(CONFIG_BT_USER_PHY_UPDATE)
static void le_phy_updated(struct bt_conn *conn,
				struct bt_conn_le_phy_info *param)
{
 char addr[BT_ADDR_LE_STR_LEN];

 bt_addr_le_to_str(bt_conn_get_dst(conn), addr, sizeof(addr));

 printk("LE PHY Updated: %s Tx 0x%x, Rx 0x%x\n", addr, param->tx_phy,
				param->rx_phy);
}
#endif /* CONFIG_BT_USER_PHY_UPDATE */

#if defined(CONFIG_BT_USER_DATA_LEN_UPDATE)
static void le_data_len_updated(struct bt_conn *conn,
			 struct bt_conn_le_data_len_info *info)
{
 char addr[BT_ADDR_LE_STR_LEN];

 bt_addr_le_to_str(bt_conn_get_dst(conn), addr, sizeof(addr));

 printk("Data length updated: %s max tx %u (%u us) max rx %u (%u us)\n",
				addr, info->tx_max_len, info->tx_max_time, info->rx_max_len,
				info->rx_max_time);
}
#endif /* CONFIG_BT_USER_DATA_LEN_UPDATE */

BT_CONN_CB_DEFINE(conn_callbacks) = {
 .connected = connected,
 .disconnected = disconnected,
 .le_param_req = le_param_req,
 .le_param_updated = le_param_updated,

#if defined(CONFIG_BT_SMP)
 .security_changed = security_changed,
#endif

#if defined(CONFIG_BT_USER_PHY_UPDATE)
 .le_phy_updated = le_phy_updated,
#endif /* CONFIG_BT_USER_PHY_UPDATE */

#if defined(CONFIG_BT_USER_DATA_LEN_UPDATE)
 .le_data_len_updated = le_data_len_updated,
#endif /* CONFIG_BT_USER_DATA_LEN_UPDATE */
};

int write_cmd(struct bt_conn *conn)
{
 static uint8_t data[BT_ATT_MAX_ATTRIBUTE_LEN] = {0, };
 static uint16_t data_len;
 uint16_t data_len_max;
 int err;

 data_len_max = bt_gatt_get_mtu(conn) - 3;
 if (data_len_max > BT_ATT_MAX_ATTRIBUTE_LEN) {
	 data_len_max = BT_ATT_MAX_ATTRIBUTE_LEN;
 }

#if TEST_FRAGMENTATION_WITH_VARIABLE_LENGTH_DATA
 /* Use incremental length data for every write command */
 /* TODO: Include test case in BabbleSim tests */
 static bool decrement;

 if (decrement) {
	 data_len--;
	 if (data_len <= 1) {
		 data_len = 1;
		 decrement = false;
	 }
 } else {
	 data_len++;
	 if (data_len >= data_len_max) {
		 data_len = data_len_max;
		 decrement = true;
	 }
 }
#else
 /* Use fixed length data for every write command */
 data_len = data_len_max;
#endif

 /* Pass the 16-bit data length value (instead of reference) in
	* user_data so that unique value is pass for each write callback.
	* Using handle 0x0001, we do not care if it is writable, we just want
	* to transmit the data across.
	*/
 err = bt_gatt_write_without_response_cb(conn, 0x0001, data, data_len,
					 false, write_cmd_cb,
					 (void *)((uint32_t)data_len));
 if (err) {
	 printk("%s: Write cmd failed (%d).\n", __func__, err);
 }

 return err;
}
```

## src/position_sender.c
```c
#include <zephyr/net/socket.h>
#include <zephyr/data/json.h>
#include <zephyr/logging/log.h>
#include <zephyr/net/net_ip.h>
#include "position_sender.h"

LOG_MODULE_REGISTER(position_sender, LOG_LEVEL_INF);

// Replace with your server IP and port
#define SERVER_ADDR "192.168.1.100"
#define SERVER_PORT 5001

struct position_data {
    double x;
    double y;
    double vx;
    double vy;
};

static const struct json_obj_descr position_descr[] = {
    JSON_OBJ_DESCR_PRIM(struct position_data, x, JSON_TOK_NUMBER),
    JSON_OBJ_DESCR_PRIM(struct position_data, y, JSON_TOK_NUMBER),
    JSON_OBJ_DESCR_PRIM(struct position_data, vx, JSON_TOK_NUMBER),
    JSON_OBJ_DESCR_PRIM(struct position_data, vy, JSON_TOK_NUMBER),
};

void send_position_data(double x, double y, double vx, double vy) {
    struct position_data pos = { x, y, vx, vy };
    char json_buf[128];

    int ret = json_obj_encode_buf(position_descr, ARRAY_SIZE(position_descr), &pos, json_buf, sizeof(json_buf));
    if (ret < 0) {
        LOG_ERR("JSON encoding failed: %d", ret);
        return;
    }

    int sock = socket(AF_INET, SOCK_STREAM, IPPROTO_TCP);
    if (sock < 0) {
        LOG_ERR("Socket creation failed: %d", errno);
        return;
    }

    struct sockaddr_in addr = {
        .sin_family = AF_INET,
        .sin_port = htons(SERVER_PORT),
    };
    inet_pton(AF_INET, SERVER_ADDR, &addr.sin_addr);

    if (connect(sock, (struct sockaddr *)&addr, sizeof(addr)) < 0) {
        LOG_ERR("Connection failed: %d", errno);
        close(sock);
        return;
    }

    char http_buf[512];
    snprintf(http_buf, sizeof(http_buf),
             "POST /position HTTP/1.1\r\n"
             "Host: %s\r\n"
             "Content-Type: application/json\r\n"
             "Content-Length: %d\r\n\r\n%s",
             SERVER_ADDR, strlen(json_buf), json_buf);

    ret = send(sock, http_buf, strlen(http_buf), 0);
    if (ret < 0) {
        LOG_ERR("Failed to send request: %d", errno);
    } else {
        LOG_INF("Position sent: x=%.2f y=%.2f vx=%.2f vy=%.2f", x, y, vx, vy);
    }

    close(sock);
}
```
